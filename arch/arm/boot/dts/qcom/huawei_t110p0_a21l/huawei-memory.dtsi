/* <DTS2014102204192 wWX239977 20141022 begin */
&soc {
        huawei,huawei-mem-hole {
                compatible = "huawei,huawei-mem-hole";
                huawei,memblock-remove-huawei = <0x9FF00000 0x100000>;
        };
     };
/* DTS2014102204192 wWX239977 20141022 end > */
