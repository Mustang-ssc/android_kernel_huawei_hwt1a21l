/* < DTS2014122301726 liyu 20141223 begin */
&soc {
        huawei,huawei-mem-hole {
                compatible = "huawei,huawei-mem-hole";
                huawei,memblock-remove-huawei = <0x9FF00000 0x100000>;
        };
     };
/* DTS2014122301726 liyu 20141223 end > */
