/* < DTS2014040807389 zhangmin 20140408 begin */
/* <DTS2014072802819 menglingchao 20140728 begin */
 / {
        huawei_wifi_info {
                  compatible = "huawei,hw_wifi_info";
                  status = "ok";
                  wifi,chiptype = "WIFI_QUALCOMM_WCN3620";
                  wifi,pubfile_id = "g620s_l01_vb";
                  wifi,fw_ver = "1.4.1.2";
        };
};
/* DTS2014072802819 menglingchao 20140728 end > */
/* DTS2014040807389 zhangmin 20140408 end > */