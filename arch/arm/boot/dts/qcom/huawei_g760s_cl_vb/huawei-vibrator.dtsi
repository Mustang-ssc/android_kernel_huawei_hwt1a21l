/* < DTS2014090505039 zhujie 20140905 begin */
&spmi_bus{
	qcom,pm8916@1 {
		pm8916_vib: qcom,vibrator@c000 {
		compatible = "qcom,qpnp-vibrator";
		qcom,vib-timeout-ms = <15000>;
		/* < DTS2014051905236 yangzhonghua 20140519 begin */
		qcom,vib-vtg-level-mV = <2800>;
		/* DTS2014051905236 yangzhonghua 20140519 end > */
		reg = <0xc000 0x100>;
		label = "vibrator";
		status = "ok";
		};
	};
};
/* DTS2014090505039 zhujie 20140905 end > */
