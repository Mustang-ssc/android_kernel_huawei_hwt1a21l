/* <DTS2014102204192 wWX239977 20141022 begin */
/* <DTS2014122507618 l00133898 20141230 begin */
/* < DTS2015010402454 lwx247446 20150104 begin */
/ {
        huawei_fac_info {
                  compatible = "huawei,hw_fac_info";
                  fac,product_name = "T1 10";
                  fac,hardware_ver = "SH1T1A23LM_VERA";
                  fac,software_ver = "T1-A23L";
                  status = "ok";
        };
};
/* DTS2015010402454 lwx247446 20150104 end > */
/* DTS2014122507618 l00133898 20141230 end > */
/* DTS2014102204192 wWX239977 20141022 end > */
