/* < DTS2014040807389 zhangmin 20140408 begin */
 / {
        huawei_wifi_info {
                  compatible = "huawei,hw_wifi_info";
                  status = "ok";
                  wifi,chiptype = "WIFI_QUALCOMM_WCN3620";
                  wifi,pubfile_id = "g620s_l02";
                  wifi,fw_ver = "1.4.1.2";
        };
};
/* DTS2014040807389 zhangmin 20140408 end > */