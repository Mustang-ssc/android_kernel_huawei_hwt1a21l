/* < DTS2014040807389 zhangmin 20140408 begin */
/* < DTS2014071006577 chenjikun 20140710 begin */
 / {
        huawei_wifi_info {
                  compatible = "huawei,hw_wifi_info";
                  status = "ok";
                  wifi,chiptype = "WIFI_QUALCOMM_WCN3620";
                  wifi,pubfile_id = "c8817d_VA";
                  wifi,fw_ver = "1.4.1.2";
        };
};
/* DTS2014071006577 chenjikun 20140710 end > */
/* DTS2014040807389 zhangmin 20140408 end > */