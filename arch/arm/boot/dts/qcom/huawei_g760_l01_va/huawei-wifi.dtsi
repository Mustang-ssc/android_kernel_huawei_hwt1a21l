/* < DTS2014040807389 zhangmin 20140408 begin */
/* < DTS2014050404951 menglingchao 20140504 begin */
 / {
        huawei_wifi_info {
                  compatible = "huawei,hw_wifi_info";
                  status = "ok";
                  wifi,chiptype = "WIFI_QUALCOMM_WCN3620";
                  wifi,pubfile_id = "g760_l01";
                  wifi,fw_ver = "1.4.1.2";
        };
};
/* DTS2014050404951 menglingchao 20140504 end > */
/* DTS2014040807389 zhangmin 20140408 end > */