/* < DTS2014052908495 lixiuzhen lwx223743 begin */
/* < DTS2014042407105 sunlibin 20140504 begin */
/*                                      Regulations
1.The "DTSxxx" just be allowed to  add at the begin and the tail.
2.The dtsi files which belong to a group need to be put together,and will be separated by remarks.
3.When we add one new boardid,it would be inherted from the similar one
 and modify the product name in the files of huawei-fac.dtsi huawei-wifi.dtsi huawei-audio.dtsi,
 and the other groups need to do some modify with DTSxxx.
*/
/*belong to the component group, according to the order of i2c lcd tp camera sensors compass tricolors vibrator begin*/
#include "huawei-i2c-detect-va.dtsi"
#include "huawei-lcd.dtsi"
#include "huawei-tp.dtsi"
/* <DTS2014053003594 wangxiaofeng 20140530 begin> */
#include "huawei-camera.dtsi"
/* <DTS2014053003594 wangxiaofeng 20140530 end> */
#include "huawei-sensors.dtsi"
/* BEGIN PN:DTS2014050902955 ,Added by z84020826, 2014/05/12*/
#include "huawei-vibrator.dtsi"
/* END PN:DTS2014050902955 ,Added by z84020826, 2014/05/12*/
/*belong to the component group, according to the order of i2c lcd tp camera sensors compass tricolors vibrator end*/
/*belong to the wireless component group, according to the order of wifi bt fm audio begin*/
#include "huawei-wifi.dtsi"
#include "huawei-bt.dtsi"
/* < DTS2014053100334 songxiaoming 20140531 begin */
#include "huawei-nfc.dtsi"
/* DTS2014053100334 songxiaoming 20140531 end > */
#include "huawei-audio.dtsi"
/*belong to the wireless component group, according to the order of wifi bt fm audio end*/
/*belong to the factory group, according to the order of fac begin*/
#include "huawei-fac.dtsi"
/*belong to the factory group, according to the order of fac end*/
/*belong to the OS group, according to the order of battery memery begin*/
/* <DTS2014051902820 chenyuanquan 20140519 begin */
#include "huawei-battery.dtsi"
/* DTS2014051902820 chenyuanquan 20140519 end> */

/*belong to the OS group, according to the order of battery memery end*/
/* DTS2014042407105 sunlibin 20140504 end> */
/* DTS2014052908495 lixiuzhen lwx223743 end > */

/* <DTS2014062506342 guohui 20140626 begin */
#include  "huawei-gpio.dtsi"
/* DTS2014062506342 guohui 20140626 end> */

/* < DTS2014082005817 lizhigang 20140819 begin */
/* Delete this line, #include "huawei-emmc.dtsi" */
/* DTS2014082005817 lizhigang 20140819 end > */
/*< DTS2015012007753 wangyuantao 20150120 begin*/
#include "huawei-memory.dtsi"
/*DTS2015012007753 wangyuantao 20150120 end >*/

