/* < DTS2014041609079 liuzhefeng 20140417 begin */
/* < DTS2014071006577 chenjikun 20140710 begin */
/* < DTS2014071506696 chuguoliang 20140715 begin */
/* < DTS2014080606606 wangbo 20140811 begin */
 / {
        huawei_fac_info {
                  compatible = "huawei,hw_fac_info";
                  fac,product_name = "G620S-UL";
                  fac,hardware_ver = "HL0MSM8916MT0";
                  fac,software_ver = "MSM8916_G620S-UL_VA";
                  status = "ok";
        };
};
/* DTS2014080606606 wangbo 20140811 end > */
/* DTS2014071506696 chuguoliang 20140715 end > */
/* DTS2014071006577 chenjikun 20140710 end > */
/*  DTS2014041609079 liuzhefeng 20140417 end > */