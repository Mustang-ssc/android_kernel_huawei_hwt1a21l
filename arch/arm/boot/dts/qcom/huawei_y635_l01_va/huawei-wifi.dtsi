/* < DTS2014101407079 tanyanying 20141014 begin */
 / {
        huawei_wifi_info {
                  compatible = "huawei,hw_wifi_info";
                  status = "ok";
                  wifi,chiptype = "WIFI_QUALCOMM_WCN3620";
                  wifi,pubfile_id = "Y630-UL01";
                  wifi,fw_ver = "1.4.1.2";
        };
};
/* DTS2014101407079 tanyanying 20141014 end > */
