/* < DTS2014071401800 menglingchao 20140714 begin */
/* < DTS2014080606606 wangbo 20140811 begin */
 / {
        huawei_fac_info {
                  compatible = "huawei,hw_fac_info";
                  fac,product_name = "G620S-UL";
                  fac,hardware_ver = "HL0MSM8916MT0";
                  fac,software_ver = "MSM8916_G620S-UL_VC";
                  status = "ok";
        };
};
/* DTS2014080606606 wangbo 20140811 end > */
/* DTS2014071401800 menglingchao 20140714 end > */