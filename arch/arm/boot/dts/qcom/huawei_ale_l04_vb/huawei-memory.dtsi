/* < DTS2015011002343 liyu 20150112 begin */
&soc {
        huawei,huawei-mem-hole {
                compatible = "huawei,huawei-mem-hole";
                huawei,memblock-remove-huawei = <0x9FF00000 0x100000>;
        };
     };
/* DTS2015011002343 liyu 20150112 end > */
