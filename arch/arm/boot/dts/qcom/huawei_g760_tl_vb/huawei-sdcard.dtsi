/* < DTS2014052200739 luchao 20140522 begin */
&soc {
        huawei,huawei-polling-support {
                compatible = "huawei-polling-support";
                huawei,support-polling;
        };
     };
/* DTS2014052200739 luchao 20140522 end > */
/*<DTS2014081308257 mazhenhua 20140819 begin */
&sdc2_cd_on {
	/delete-property/ bias-pull-up;
	/delete-property/ bias-disable;
	bias-pull-down;
};
/*DTS2014081308257 mazhenhua 20140819 end >*/
