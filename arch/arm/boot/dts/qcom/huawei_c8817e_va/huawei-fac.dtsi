/* < DTS2014042602179 zhanggong 20140426 begin */
/* < DTS2014071006577 chenjikun 20140710 begin */
/* < DTS2014071506696 chuguoliang 20140715 begin */
 / {
        huawei_fac_info {
                  compatible = "huawei,hw_fac_info";
                  fac,product_name = "HUAWEI C8817E";
                  fac,hardware_ver = "HL0MSM8916MT0";
                  fac,software_ver = "MSM8916_C8817E_VA";
                  status = "ok";
        };
};
/* DTS2014071506696 chuguoliang 20140715 end > */
/* DTS2014071006577 chenjikun 20140710 end > */
/*  DTS2014042602179 zhanggong 20140426 end > */