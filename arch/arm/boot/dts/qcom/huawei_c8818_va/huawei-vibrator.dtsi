/* < DTS2014121706484  liyu 20141217 begin */
&spmi_bus{
	qcom,pm8916@1 {
		pm8916_vib: qcom,vibrator@c000 {
		compatible = "qcom,qpnp-vibrator";
		qcom,vib-timeout-ms = <15000>;
		qcom,vib-vtg-level-mV = <3000>;
		reg = <0xc000 0x100>;
		label = "vibrator";
		status = "ok";
		};
	};
};
/* DTS2014121706484 liyu 20141217 end > */
