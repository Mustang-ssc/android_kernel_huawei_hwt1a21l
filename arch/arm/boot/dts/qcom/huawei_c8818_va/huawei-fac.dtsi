/* < DTS2014121706484  liyu 20141217 begin */
/* < DTS2014122301726 liyu 20141223 begin */
 / {
        huawei_fac_info {
                  compatible = "huawei,hw_fac_info";
                  fac,product_name = "HUAWEI C8818";
                  fac,hardware_ver = "HL1CHMCLM";
                  fac,software_ver = "MSM8939_C8818_VA";
                  status = "ok";
        };
};
/* DTS2014122301726 liyu 20141223 end > */
/* DTS2014121706484  liyu 20141212 end > */