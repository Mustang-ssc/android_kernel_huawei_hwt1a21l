/* < DTS2014041604760 shaopengxiang 20140417 begin */
 / {
        huawei_bt_info {
                  compatible = "huawei,hw_bt_info";
                  status = "ok";
                  bt,fw_ver = "1.4.1.2";
                  bt,chiptype = "BT_FM_QUALCOMM_WCN3620";
        };
};
/* DTS2014041604760 shaopengxiang 20140417 end > */