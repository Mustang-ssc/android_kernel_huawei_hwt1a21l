/* < DTS2014101407079 tanyanying 20141014 begin */
/*                                      Regulations
1.The "DTSxxx" just be allowed to  add at the begin and the tail.
2.The dtsi files which belong to a group need to be put together,and will be separated by remarks.
3.When we add one new boardid,it would be inherted from the similar one
 and modify the product name in the files of huawei-fac.dtsi huawei-wifi.dtsi huawei-audio.dtsi,
 and the other groups need to do some modify with DTSxxx.
*/
/*belong to the component group, according to the order of i2c lcd tp camera sensors compass tricolors vibrator begin*/
#include "huawei-i2c-detect-va.dtsi"

#include "huawei-tp.dtsi"
/* < DTS2014062408461 daiyuhong 20140624 begin */
#include "huawei-lcd.dtsi"
/* DTS2014062408461 daiyuhong 20140624 end > */
#include "huawei-sensors.dtsi"
/* BEGIN PN:DTS2014050902955 ,Added by z84020826, 2014/05/12*/
#include "huawei-vibrator.dtsi"
/* END PN:DTS2014050902955 ,Added by z84020826, 2014/05/12*/

/* camera module  */
#include "huawei-camera.dtsi"

/*belong to the component group, according to the order of i2c lcd tp camera sensors compass tricolors vibrator end*/

/*belong to the wireless component group, according to the order of wifi bt fm audio begin*/
#include "huawei-wifi.dtsi"
#include "huawei-bt.dtsi"

#include "huawei-audio.dtsi"
/*belong to the wireless component group, according to the order of wifi bt fm audio end*/

/*belong to the factory group, according to the order of fac begin*/
#include "huawei-fac.dtsi"
/*belong to the factory group, according to the order of fac end*/

/*belong to the OS group, according to the order of battery memery begin*/
/* <DTS2014051902820 chenyuanquan 20140519 begin */
#include "huawei-battery.dtsi"
/* DTS2014051902820 chenyuanquan 20140519 end> */
/* < DTS2014110303279 yuanxiaofeng 20141103 begin */
#include "huawei-sdcard.dtsi"
/* DTS2014110303279 yuanxiaofeng 20141103 end > */
/*belong to the OS group, according to the order of battery memery end*/
/* DTS2014101407079 tanyanying 20141014 end > */

/*DTS2014101608712 zhaoyong 20141016 begin*/
#include "huawei-nfc.dtsi"
/*DTS2014101608712 zhaoyong 20141016 end*/
/*< DTS2015012007753 wangyuantao 20150120 begin*/
#include "huawei-memory.dtsi"
/*DTS2015012007753 wangyuantao 20150120 end >*/
