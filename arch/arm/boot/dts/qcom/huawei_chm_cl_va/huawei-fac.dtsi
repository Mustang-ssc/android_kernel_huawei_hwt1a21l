/* <DTS2014121900990 rentianzhi 20141219 begin */
/* < DTS2014111203130 tanyanying 20141113 begin */
 / {
        huawei_fac_info {
                  compatible = "huawei,hw_fac_info";
                  fac,product_name = "HUAWEI CHM-CL00";
                  fac,hardware_ver = "HL1CHMCLM";
                  fac,software_ver = "MSM8939_CHM-CL00_VA";
                  status = "ok";
        };
};
/* DTS2014111203130 tanyanying 20141113 end > */
/* DTS2014121900990 rentianzhi 20141219 end > */
