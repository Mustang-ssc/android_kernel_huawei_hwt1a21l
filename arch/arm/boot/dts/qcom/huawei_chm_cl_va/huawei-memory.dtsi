/* < DTS2014111203130 tanyanying 20141113 begin */
&soc {
        huawei,huawei-mem-hole {
                compatible = "huawei,huawei-mem-hole";
                huawei,memblock-remove-huawei = <0x9FF00000 0x100000>;
        };
     };
/* DTS2014111203130 tanyanying 20141113 end > */
