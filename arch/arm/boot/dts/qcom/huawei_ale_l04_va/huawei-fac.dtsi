/* < DTS2014111203130 tanyanying 20141113 begin */
/* < DTS2014120204179 liyu 20141202 begin */
/* < DTS2015011002343 liyu 20150112 begin */
 / {
        huawei_fac_info {
                  compatible = "huawei,hw_fac_info";
                  fac,product_name = "HUAWEI ALE_L04";
                  fac,hardware_ver = "HL4ALICETM";
                  fac,software_ver = "MSM8939_ALE_L04_VA";
                  status = "ok";
        };
};
/* DTS2015011002343 liyu 20150112 end > */
/* < DTS2014120204179 liyu 20141202 begin */
/* DTS2014111203130 tanyanying 20141113 end > */