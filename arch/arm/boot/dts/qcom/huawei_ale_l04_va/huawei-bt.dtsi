/* < DTS2014111203130 tanyanying 20141113 begin */
/* < DTS2014120204179 liyu 20141202 begin */
 / {
        huawei_bt_info {
                  compatible = "huawei,hw_bt_info";
                  status = "ok";
                  bt,fw_ver = "1.4.1.2";
                  bt,chiptype = "BT_FM_QUALCOMM_WCN3620";
        };
};
/* DTS2014120204179 liyu 20141202 end > */
/* DTS2014111203130 tanyanying 20141113 end > */