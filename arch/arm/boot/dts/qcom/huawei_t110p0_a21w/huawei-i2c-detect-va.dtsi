/* <DTS2014102204192 wWX239977 20141022 begin */
/* <DTS2014121203348 zhanglei 20141212 begin */
/{
        /* < DTS2014101501646 gwx199358 20141015 begin */
	hw-dev-detect {
		compatible = "huawei,hw-dev-detect";
		reg = <0x0 0x12C>;
		i2c,touch_panel = <1>;
		i2c,compass = <0>;
		i2c,g_sensor = <1>;
		i2c,camera_main = <1>;
		i2c,camera_slave = <1>;
		i2c,keypad = <0>;
		i2c,aps = <1>;
		i2c,gyroscope = <0>;
		i2c,nfc = <0>;
		i2c,dc_dc = <0>;
		i2c,speaker = <0>;
		i2c,ofn = <0>;
		i2c,flash = <1>;
		i2c,l_sensor = <1>;
		i2c,charge = <1>;
		i2c,battery = <0>;
		i2c,ntc = <0>;
		i2c,mhl = <0>;
		i2c,audience = <0>;
		status = "ok";
	};
        /* DTS2014101501646 gwx199358 20141015 end > */
};
/* DTS2014121203348 zhanglei 20141212 end>*/
/* DTS2014102204192 wWX239977 20141022 end > */
