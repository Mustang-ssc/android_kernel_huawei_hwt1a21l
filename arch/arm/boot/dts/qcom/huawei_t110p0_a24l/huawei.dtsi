/* <DTS2014102204192 wWX239977 20141022 begin */
/*                                      Regulations
1.The "DTSxxx" just be allowed to  add at the begin and the tail.
2.The dtsi files which belong to a group need to be put together,and will be separated by remarks.
3.When we add one new boardid,it would be inherted from the similar one
 and modify the product name in the files of huawei-fac.dtsi huawei-wifi.dtsi huawei-audio.dtsi,
 and the other groups need to do some modify with DTSxxx.
*/
/*belong to the component group, according to the order of i2c lcd tp camera sensors compass tricolors vibrator begin*/
#include "huawei-i2c-detect-va.dtsi"
#include "huawei-lcd.dtsi"
#include "huawei-tp.dtsi"
#include "huawei-camera.dtsi"
#include "huawei-sensors.dtsi"
#include "huawei-vibrator.dtsi"
/*belong to the component group, according to the order of i2c lcd tp camera sensors compass tricolors vibrator end*/

/*belong to the wireless component group, according to the order of wifi bt fm audio begin*/
#include "huawei-wifi.dtsi"
#include "huawei-bt.dtsi"

#include "huawei-audio.dtsi"
/*belong to the wireless component group, according to the order of wifi bt fm audio end*/

/*belong to the factory group, according to the order of fac begin*/
#include "huawei-fac.dtsi"
/*belong to the factory group, according to the order of fac end*/

/*belong to the OS group, according to the order of battery memery begin*/
#include "huawei-battery.dtsi"

#include "huawei-memory.dtsi"
/*belong to the OS group, according to the order of battery memery end*/
/*<DTS2014120404594 zhanglei wx200260 20141204 begin */
/* Begin DTS2014070706478 for sim detect by c00217097 2014/7/7  */
#include "huawei-sim.dtsi"
/* End DTS2014070706478 for sim detect by c00217097 2014/7/7  */
/*DTS2014120404594 zhanglei wx200260 20141204 end> */
#include "huawei-usb.dtsi"
#include "huawei-sdcard.dtsi"

/* < DTS2015012906159   l00133898 20150129 begin */
#include "huawei-emmc.dtsi"
/* DTS2015012906159   l00133898 20150129 end > */

/* DTS2014102204192 wWX239977 20141022 end > */
