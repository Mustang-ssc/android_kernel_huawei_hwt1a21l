/* < DTS2014072906612 lijulong  20140804 begin */
/* < DTS2014071401800 menglingchao 20140714 begin */
/* < DTS2014080606606 wangbo 20140811 begin */
 / {
        huawei_fac_info {
                  compatible = "huawei,hw_fac_info";
                  fac,product_name = "G621-TL00";
                  fac,hardware_ver = "HL0MSM8916MT0";
                  fac,software_ver = "MSM8916_G621-TL_VC";
                  status = "ok";
        };
};
/* DTS2014080606606 wangbo 20140811 end > */
/* DTS2014071401800 menglingchao 20140714 end > */
/* DTS2014072906612 lijulong   20140804 end > */