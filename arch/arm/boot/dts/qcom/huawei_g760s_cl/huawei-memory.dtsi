/* < DTS2014090505039 zhujie 20140905 begin */
&soc {
        huawei,huawei-mem-hole {
                compatible = "huawei,huawei-mem-hole";
                huawei,memblock-remove-huawei = <0x9FF00000 0x100000>;
        };
     };
/* DTS2014090505039 zhujie 20140905 end > */