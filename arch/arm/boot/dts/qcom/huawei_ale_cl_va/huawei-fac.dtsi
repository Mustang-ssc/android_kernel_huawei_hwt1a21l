/* < DTS2014111203130 tanyanying 20141113 begin */
 / {
        huawei_fac_info {
                  compatible = "huawei,hw_fac_info";
                  fac,product_name = "HUAWEI ALE-CL00";
                  fac,hardware_ver = "HL4ALICETM";
                  fac,software_ver = "MSM8939_ALE-CL00_VA";
                  status = "ok";
        };
};
/* DTS2014111203130 tanyanying 20141113 end > */