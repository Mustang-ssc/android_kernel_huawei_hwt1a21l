/* < DTS2014111203130 tanyanying 20141113 begin */
 / {
        huawei_wifi_info {
                  compatible = "huawei,hw_wifi_info";
                  status = "ok";
                  wifi,chiptype = "WIFI_QUALCOMM_WCN3620";
                  wifi,pubfile_id = "ALE-CL00";
                  wifi,fw_ver = "1.4.1.2";
        };
};
/* DTS2014111203130 tanyanying 20141113 end > */