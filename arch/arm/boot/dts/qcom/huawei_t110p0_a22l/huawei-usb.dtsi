/* <DTS2014102204192 wWX239977 20141022 begin */
 &usb_otg {  
       qcom,hsusb-otg-mode = <3>;  
       qcom,usbid-gpio = <&msm_gpio 110 0>;   
       pinctrl-names = "default";   
       pinctrl-0 = <&usbid_default>; 
};  
/* DTS2014102204192 wWX239977 20141022 end > */
