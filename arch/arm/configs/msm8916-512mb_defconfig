## drivers/cpu_stress/Kconfig
```kconfig
#/* < DTS2014102104433 liwei 20141021 begin */
config CPU_STRESS_TEST
	bool "CPU stress test support"
	default n
#/* DTS2014102104433 liwei 20141021 end > */
```

## drivers/devdetect/Kconfig
```kconfig
#/* < DTS2014041705903 zhangmin 20140418 begin */

#
# Near Field Communication (NFC) devices
#

config HUAWEI_HW_DEV_DCT
	depends on HUAWEI_KERNEL
	default n
	bool "HUAWEI DEVICE DETECT"
	help
		Say yes if you want i2c device detect driver.
		This is for i2c connected version. If unsure, say N here.

#/* DTS2014041705903 zhangmin 20140418 end > */
#/*<DTS2014120404594 zhanglei wx200260 20141204 begin */
#/* begin DTS2014070706478 for sim detect by c00217097 2014/7/7  */

config HUAWEI_HW_SIM_DETECT
	depends on HUAWEI_KERNEL
	default n
	bool "HUAWEI SIM DEVICE DETECT"
	help
		Say yes if you want sim device detect driver.
		This is for sim plugin version. If unsure, say N here.
		
#/* End DTS2014070706478 for sim detect by c00217097  2014/7/7  */
#/*DTS2014120404594 zhanglei wx200260 20141204 end> */		
```

## drivers/huawei/Kconfig
```kconfig
#/* < DTS2014060603241 chenjikun 20140610 add >*/
menu "huawei linux device driver support package"
source "drivers/huawei/log_module/Kconfig"
#Begin DTS2014072507555 c00278899 201407226 Add equip driver
source "drivers/huawei/equip/Kconfig"
#End DTS2014072507555  c00278899 20140726 Add equip driver

#/* < DTS2014082110037 chenqihang 20140821 begin */
source "drivers/huawei/store_exception/Kconfig"
#/* DTS2014082110037 chenqihang 20140821 end> */
endmenu
```

## drivers/huawei/equip/Kconfig
```kconfig
#
# equip driver configuration
#

#/*Begin <DTS2012120510674>  add by nielimin/00164272 for normalizing internal interface of AT command  2012/12/5*/
config DEV_EQUIP
	bool "equip driver"
	default y
	help
	  Say Y to enable equip driver  
#/*End <DTS2012120510674>  add by nielimin/00164272 for normalizing internal interface of AT command  2012/12/5*/
```

## drivers/huawei/log_module/Kconfig
```kconfig
#/* < DTS2014060603241 chenjikun 20140610 add >*/
menu HUAWEI_LOG_MODULE

config  HUAWEI_LOG_MODULE
        default n
	bool "huawei log module"
	help
          huawei log module control

endmenu
```

## drivers/misc/dsm/Kconfig
```kconfig
#/* < DTS2014042900710 shenjinming 20140430 begin */
#
# huawei device state monitor configuration
#

config HUAWEI_DSM
	bool "huawei dsm"
	default n
	help
	  If you say yes here you get support for huawei touchscreen.
#/* <DTS2014070104755 hangtianqi hwx220732 20140701 begin */
config HUAWEI_SDCARD_VOLD
	bool "huawei sdcard vold"
#/* DTS2014071101173 hangtianqi hwx220732 20140711 begin */
	default n
#/* DTS2014071101173 hangtianqi hwx220732 20140711 end */
	help
	  If you say yes here you get support for huawei vold radar.
#/* <DTS2014070104755 hangtianqi hwx220732 20140701 end */
#/* DTS2014042900710 shenjinming 20140430 end > */
```

## drivers/misc/huawei_apanic/Kconfig
```kconfig
#/* < DTS2013080201182 wuzhihui 20130802 begin */
config HUAWEI_APANIC
	tristate "dump panic info"
	depends on HUAWEI_KERNEL
	default n
	help
	  Say Y here to enable huawei panic info dump
#/* DTS2013080201182 wuzhihui 20130802 end > */
```

## drivers/misc/hw_kstate/Kconfig
```kconfig
#/* < DTS2014021207582 xufeng 20140212 begin */
config HUAWEI_KSTATE
    tristate "Huawei Kernel State"
    help
        Huawei kernel state, please choose it.
#/* DTS2014021207582 xufeng 20140212 end > */
```
