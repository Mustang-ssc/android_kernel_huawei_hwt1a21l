## arch/arm/configs/msm8916-512mb_defconfig
```kconfig
# CONFIG_ARM_PATCH_PHYS_VIRT is not set
CONFIG_SYSVIPC=y
CONFIG_NO_HZ=y
CONFIG_HIGH_RES_TIMERS=y
CONFIG_AUDIT=y
CONFIG_RCU_FAST_NO_HZ=y
CONFIG_IKCONFIG=y
#/*<DTS2014061705620 roopesh 20140625 begin*/
# CONFIG_IKCONFIG_PROC is not set
#/*DTS2014061705620 roopesh 20140625 end>*/
CONFIG_CGROUPS=y
CONFIG_CGROUP_DEBUG=y
CONFIG_CGROUP_FREEZER=y
CONFIG_CGROUP_CPUACCT=y
CONFIG_RESOURCE_COUNTERS=y
CONFIG_CGROUP_SCHED=y
CONFIG_RT_GROUP_SCHED=y
CONFIG_NAMESPACES=y
# CONFIG_UTS_NS is not set
# CONFIG_IPC_NS is not set
# CONFIG_PID_NS is not set
CONFIG_RELAY=y
CONFIG_BLK_DEV_INITRD=y
CONFIG_RD_BZIP2=y
CONFIG_RD_LZMA=y
CONFIG_CC_OPTIMIZE_FOR_SIZE=y
CONFIG_PANIC_TIMEOUT=5
CONFIG_KALLSYMS_ALL=y
CONFIG_EMBEDDED=y
CONFIG_PROFILING=y
CONFIG_OPROFILE=m
CONFIG_KPROBES=y
CONFIG_MODULES=y
CONFIG_MODULE_UNLOAD=y
CONFIG_MODULE_FORCE_UNLOAD=y
CONFIG_MODVERSIONS=y
CONFIG_PARTITION_ADVANCED=y
CONFIG_ARCH_MSM=y
CONFIG_ARCH_MSM8916=y
# CONFIG_MSM_STACKED_MEMORY is not set
CONFIG_LEDS_MSM_GPIO_FLASH=y
CONFIG_CPU_HAS_L2_PMU=y
CONFIG_MSM_SMCMOD=y
CONFIG_MSM_TZ_LOG=y
CONFIG_MSM_DIRECT_SCLK_ACCESS=y
CONFIG_MSM_BUS_SCALING=y
CONFIG_BUS_TOPOLOGY_ADHOC=y
CONFIG_MSM_WATCHDOG_V2=y
CONFIG_MSM_DLOAD_MODE=y
CONFIG_MSM_ADSP_LOADER=y
CONFIG_SENSORS_ADSP=y
CONFIG_MSM_ENABLE_WDOG_DEBUG_CONTROL=y
CONFIG_MSM_BOOT_STATS=y
CONFIG_MSM_XPU_ERR_FATAL=y
CONFIG_SMP=y
CONFIG_SCHED_MC=y
CONFIG_PREEMPT=y
CONFIG_AEABI=y
CONFIG_KSM=y
CONFIG_BALANCE_ANON_FILE_RECLAIM=y
CONFIG_CC_STACKPROTECTOR=y
CONFIG_CP_ACCESS=y
CONFIG_ARM_DECOMPRESSOR_LIMIT=0x3200000
CONFIG_CPU_FREQ_GOV_POWERSAVE=y
CONFIG_CPU_FREQ_GOV_USERSPACE=y
CONFIG_CPU_FREQ_GOV_ONDEMAND=y
CONFIG_CPU_FREQ_GOV_INTERACTIVE=y
CONFIG_CPU_IDLE=y
CONFIG_VFP=y
CONFIG_NEON=y
# CONFIG_CORE_DUMP_DEFAULT_ELF_HEADERS is not set
CONFIG_PM_AUTOSLEEP=y
CONFIG_PM_WAKELOCKS=y
CONFIG_PM_WAKELOCKS_LIMIT=0
# CONFIG_PM_WAKELOCKS_GC is not set
CONFIG_PM_RUNTIME=y
CONFIG_NET=y
CONFIG_PACKET=y
CONFIG_UNIX=y
CONFIG_XFRM_USER=y
CONFIG_INET=y
CONFIG_INET_AH=y
CONFIG_INET_ESP=y
CONFIG_IP_ADVANCED_ROUTER=y
CONFIG_IP_MULTIPLE_TABLES=y
CONFIG_IP_ROUTE_VERBOSE=y
CONFIG_IP_PNP=y
CONFIG_IP_PNP_DHCP=y
CONFIG_INET_XFRM_MODE_TRANSPORT=y
CONFIG_INET_XFRM_MODE_TUNNEL=y
# CONFIG_INET_XFRM_MODE_BEET is not set
# CONFIG_INET_LRO is not set
CONFIG_IPV6=y
CONFIG_IPV6_PRIVACY=y
CONFIG_IPV6_ROUTER_PREF=y
CONFIG_IPV6_ROUTE_INFO=y
CONFIG_IPV6_OPTIMISTIC_DAD=y
CONFIG_INET6_AH=y
CONFIG_INET6_ESP=y
CONFIG_INET6_IPCOMP=y
CONFIG_IPV6_MIP6=y
CONFIG_IPV6_MULTIPLE_TABLES=y
CONFIG_IPV6_SUBTREES=y
CONFIG_NETFILTER=y
CONFIG_NETFILTER_NETLINK_LOG=y
CONFIG_NF_CONNTRACK=y
CONFIG_NF_CONNTRACK_SECMARK=y
CONFIG_NF_CONNTRACK_EVENTS=y
CONFIG_NF_CT_PROTO_DCCP=y
CONFIG_NF_CT_PROTO_SCTP=y
CONFIG_NF_CT_PROTO_UDPLITE=y
CONFIG_NF_CONNTRACK_AMANDA=y
CONFIG_NF_CONNTRACK_FTP=y
CONFIG_NF_CONNTRACK_H323=y
CONFIG_NF_CONNTRACK_IRC=y
CONFIG_NF_CONNTRACK_NETBIOS_NS=y
CONFIG_NF_CONNTRACK_PPTP=y
CONFIG_NF_CONNTRACK_SANE=y
CONFIG_NF_CONNTRACK_SIP=y
CONFIG_NF_CONNTRACK_TFTP=y
CONFIG_NF_CT_NETLINK=y
CONFIG_NETFILTER_TPROXY=y
CONFIG_NETFILTER_XT_TARGET_CLASSIFY=y
CONFIG_NETFILTER_XT_TARGET_CONNMARK=y
CONFIG_NETFILTER_XT_TARGET_CONNSECMARK=y
CONFIG_NETFILTER_XT_TARGET_HARDIDLETIMER=y
CONFIG_NETFILTER_XT_TARGET_LOG=y
CONFIG_NETFILTER_XT_TARGET_MARK=y
CONFIG_NETFILTER_XT_TARGET_NFLOG=y
CONFIG_NETFILTER_XT_TARGET_NFQUEUE=y
CONFIG_NETFILTER_XT_TARGET_TPROXY=y
CONFIG_NETFILTER_XT_TARGET_NOTRACK=y
CONFIG_NETFILTER_XT_TARGET_TRACE=y
CONFIG_NETFILTER_XT_TARGET_SECMARK=y
CONFIG_NETFILTER_XT_MATCH_COMMENT=y
CONFIG_NETFILTER_XT_MATCH_CONNLIMIT=y
CONFIG_NETFILTER_XT_MATCH_CONNMARK=y
CONFIG_NETFILTER_XT_MATCH_CONNTRACK=y
CONFIG_NETFILTER_XT_MATCH_DSCP=y
CONFIG_NETFILTER_XT_MATCH_HASHLIMIT=y
CONFIG_NETFILTER_XT_MATCH_HELPER=y
CONFIG_NETFILTER_XT_MATCH_IPRANGE=y
CONFIG_NETFILTER_XT_MATCH_LENGTH=y
CONFIG_NETFILTER_XT_MATCH_LIMIT=y
CONFIG_NETFILTER_XT_MATCH_MAC=y
CONFIG_NETFILTER_XT_MATCH_MARK=y
CONFIG_NETFILTER_XT_MATCH_MULTIPORT=y
CONFIG_NETFILTER_XT_MATCH_POLICY=y
CONFIG_NETFILTER_XT_MATCH_PKTTYPE=y
CONFIG_NETFILTER_XT_MATCH_QTAGUID=y
CONFIG_NETFILTER_XT_MATCH_QUOTA=y
CONFIG_NETFILTER_XT_MATCH_QUOTA2=y
CONFIG_NETFILTER_XT_MATCH_QUOTA2_LOG=y
CONFIG_NETFILTER_XT_MATCH_SOCKET=y
CONFIG_NETFILTER_XT_MATCH_STATE=y
CONFIG_NETFILTER_XT_MATCH_STATISTIC=y
CONFIG_NETFILTER_XT_MATCH_STRING=y
CONFIG_NETFILTER_XT_MATCH_TIME=y
CONFIG_NETFILTER_XT_MATCH_U32=y
CONFIG_NETFILTER_XT_MATCH_ESP=y
CONFIG_NF_CONNTRACK_IPV4=y
CONFIG_IP_NF_IPTABLES=y
CONFIG_IP_NF_MATCH_AH=y
CONFIG_IP_NF_MATCH_ECN=y
CONFIG_IP_NF_MATCH_TTL=y
CONFIG_IP_NF_FILTER=y
CONFIG_IP_NF_TARGET_REJECT=y
CONFIG_NF_NAT_IPV4=y
CONFIG_IP_NF_TARGET_MASQUERADE=y
CONFIG_IP_NF_TARGET_NETMAP=y
CONFIG_IP_NF_TARGET_REDIRECT=y
CONFIG_IP_NF_MANGLE=y
CONFIG_IP_NF_RAW=y
CONFIG_IP_NF_SECURITY=y
CONFIG_IP_NF_ARPTABLES=y
CONFIG_IP_NF_ARPFILTER=y
CONFIG_IP_NF_ARP_MANGLE=y
CONFIG_NF_CONNTRACK_IPV6=y
CONFIG_IP6_NF_IPTABLES=y
CONFIG_IP6_NF_FILTER=y
CONFIG_IP6_NF_TARGET_REJECT=y
CONFIG_IP6_NF_MANGLE=y
CONFIG_IP6_NF_RAW=y
CONFIG_BRIDGE_NF_EBTABLES=y
CONFIG_BRIDGE_EBT_BROUTE=y
CONFIG_BRIDGE=y
CONFIG_NET_SCHED=y
CONFIG_NET_SCH_HTB=y
CONFIG_NET_SCH_PRIO=y
CONFIG_NET_CLS_FW=y
CONFIG_NET_CLS_U32=y
CONFIG_CLS_U32_MARK=y
CONFIG_NET_CLS_FLOW=y
CONFIG_NET_EMATCH=y
CONFIG_NET_EMATCH_CMP=y
CONFIG_NET_EMATCH_NBYTE=y
CONFIG_NET_EMATCH_U32=y
CONFIG_NET_EMATCH_META=y
CONFIG_NET_EMATCH_TEXT=y
CONFIG_NET_CLS_ACT=y
CONFIG_RMNET_DATA=y
CONFIG_RMNET_DATA_FC=y
CONFIG_RMNET_DATA_DEBUG_PKT=y
CONFIG_SOCKEV_NLMCAST=y
CONFIG_BT=y
CONFIG_BT_RFCOMM=y
CONFIG_BT_RFCOMM_TTY=y
CONFIG_BT_BNEP=y
CONFIG_BT_BNEP_MC_FILTER=y
CONFIG_BT_BNEP_PROTO_FILTER=y
CONFIG_BT_HIDP=y
#/* < DTS2014041604760 shaopengxiang 20140417 begin */
CONFIG_HUAWEI_FM=y
#/* DTS2014041604760 shaopengxiang 20140417 end > */
CONFIG_CFG80211=y
CONFIG_NL80211_TESTMODE=y
CONFIG_CFG80211_INTERNAL_REGDB=y
CONFIG_NFC_QNCI=y
CONFIG_IPC_ROUTER=y
CONFIG_IPC_ROUTER_SECURITY=y
CONFIG_CMA=y
CONFIG_CMA_SIZE_MBYTES=8
CONFIG_BLK_DEV_LOOP=y
CONFIG_BLK_DEV_RAM=y
#/* < DTS2014051304400 caowei 201400515 begin */
#/* < DTS2014081207594 wanghang 20140812 begin */
CONFIG_APDS993X=y
#/* DTS2014081207594 wanghang 20140812 end > */
#/* < DTS2014052206888 yangxiaomei 20140523 begin */
CONFIG_HUAWEI_HALL_AK8789=y
#/* DTS2014052206888 yangxiaomei 20140523 end > */
#/* DTS2014051304400 caowei 201400515 end >*/
CONFIG_QSEECOM=y
CONFIG_SCSI=y
CONFIG_SCSI_TGT=y
CONFIG_BLK_DEV_SD=y
CONFIG_CHR_DEV_SG=y
CONFIG_CHR_DEV_SCH=y
CONFIG_SCSI_MULTI_LUN=y
CONFIG_SCSI_CONSTANTS=y
CONFIG_SCSI_LOGGING=y
CONFIG_SCSI_SCAN_ASYNC=y
CONFIG_MD=y
CONFIG_BLK_DEV_DM=y
CONFIG_DM_CRYPT=y
CONFIG_NETDEVICES=y
CONFIG_DUMMY=y
CONFIG_TUN=y
CONFIG_KS8851=y
CONFIG_MSM_RMNET_BAM=y
CONFIG_PPP=y
CONFIG_PPP_BSDCOMP=y
CONFIG_PPP_DEFLATE=y
CONFIG_PPPOE=y
CONFIG_PPP_ASYNC=y
CONFIG_PPP_SYNC_TTY=y
CONFIG_USB_USBNET=y
CONFIG_WCNSS_CORE=y
CONFIG_WCNSS_CORE_PRONTO=y
CONFIG_WCNSS_MEM_PRE_ALLOC=y
#/* < DTS2014041008275 chenjikun 20140410 begin */
CONFIG_HUAWEI_WIFI=y
#/* DTS2014041008275 chenjikun 20140410 end > */
CONFIG_INPUT_EVDEV=y
CONFIG_INPUT_EVBUG=m
CONFIG_KEYBOARD_GPIO=y
CONFIG_INPUT_JOYSTICK=y
CONFIG_JOYSTICK_XPAD=y
CONFIG_INPUT_TOUCHSCREEN=y
CONFIG_TOUCHSCREEN_ATMEL_MXT=y
CONFIG_TOUCHSCREEN_FT5X06=y
CONFIG_TOUCHSCREEN_MSTAR21XX=y
CONFIG_TOUCHSCREEN_GEN_VKEYS=y
CONFIG_TOUCHSCREEN_SYNAPTICS_I2C_RMI4=y
CONFIG_TOUCHSCREEN_SYNAPTICS_DSX_RMI4_DEV=y
CONFIG_TOUCHSCREEN_SYNAPTICS_DSX_FW_UPDATE=y
#/* < DTS2014080506603  caowei 201400806 begin */
CONFIG_TOUCHSCREEN_HUAWEI_DSX_ESD=y
#/* DTS2014080506603  caowei 201400806 end >*/
#/* < DTS2014041202666  yangzicheng 20140412 begin */
CONFIG_TOUCHSCREEN_HUAWEI_FOCALTECH_FT6X06=y
CONFIG_FOCALTECH_F6X06_TP_ENABLE=y
CONFIG_FOCALTECH_FT6X06_UPDATA_FW=y
CONFIG_FOCALTECH_FT6X06_TS=y
CONFIG_FOCALTECH_FT6X06_SYSDEBUG=y
CONFIG_FOCALTECH_FT6X06_SCAP_TEST=y
CONFIG_TOUCHSCREEN_HUAWEI_MSTAR_MSG21XX=y
CONFIG_MSG2138_GC=y
CONFIG_MSG2138_SCAP_TEST=y
#/* DTS2014041202666  yangzicheng 20140412 end >*/
#/* < DTS2014042402686 sunlibin 20140424 begin */
#/*Add synaptics new driver "Synaptics DSX I2C V2.0"*/
CONFIG_TOUCHSCREEN_HUAWEI_SYNAPTICS_DSX_v20=y
CONFIG_TOUCHSCREEN_HUAWEI_DSX_I2C=y
CONFIG_TOUCHSCREEN_HUAWEI_DSX_RMI_DEV=y
CONFIG_TOUCHSCREEN_HUAWEI_DSX_FW_UPDATE=y
CONFIG_TOUCHSCREEN_HUAWEI_DSX_TEST_REPORTING=y
#/* < DTS2014042407105 sunlibin 20140504 begin */
# CONFIG_TOUCHSCREEN_HUAWEI_DSX_PROXIMITY is not set
#/* DTS2014042407105 sunlibin 20140504 end> */
#/* < DTS2014062006092  songrongyuan 20140620 begin */
CONFIG_GT9XX_TOUCHPANEL_DRIVER=y
CONFIG_GT9XX_TOUCHPANEL_UPDATE=y
CONFIG_GT9XX_TOUCHPANEL_DEBUG=y
CONFIG_GT9XX_TOUCHPANEL_OPENSHORT_TEST=y
#/* DTS2014062006092  songrongyuan 20140620 end >*/
#/* DTS2014042402686 sunlibin 20140424 end> */
#/* < DTS2014042900710 shenjinming 20140430 begin */
CONFIG_HUAWEI_DSM=y
#/* DTS2014042900710 shenjinming 20140430 end > */
CONFIG_INPUT_MISC=y
CONFIG_INPUT_UINPUT=y
CONFIG_INPUT_GPIO=m
CONFIG_SENSORS_LIS3DH=y
#/* < DTS2014042306752 yangxiaomei 20140424 begin */
CONFIG_SENSORS_KIONIX=y
#/* DTS2014042306752 yangxiaomei 20140424 end > */
#/* < DTS2015072707140 chendong wx241705 begin */
CONFIG_SENSORS_ADUX1050=y
#/* DTS2015072707140 chendong wx241705 end > */
CONFIG_SENSORS_MPU6050=y
#/* < DTS2015090109210 chendong wx241705 begin */
CONFIG_SENSORS_AKM09911=n
CONFIG_SENSORS_BMA2X2=y
CONFIG_SENSORS_MMC3416X=y
CONFIG_SENSORS_AKM8963=n
#/* DTS2015090109210 chendong wx241705 end > */
#/*< DTS2014061900098 p00105636 20140612 begin*/
#/* < DTS2014082700877 z00202435 20140818 begin */
CONFIG_SERIAL_MSM_HSL=y
CONFIG_SERIAL_MSM_HSL_CONSOLE=y
#/* DTS2014082700877 z00202435 20140818 end > */
#/*DTS2014061900098 p00105636 20140612 end >*/
CONFIG_SERIAL_MSM_SMD=y
CONFIG_DIAG_CHAR=y
CONFIG_HW_RANDOM=y
CONFIG_HW_RANDOM_MSM=y
CONFIG_MSM_SMD_PKT=y
CONFIG_I2C=y
CONFIG_I2C_CHARDEV=y
CONFIG_I2C_MSM_V2=y
CONFIG_SLIMBUS=y
CONFIG_SPI=y
CONFIG_SPI_QUP=y
CONFIG_SPI_SPIDEV=m
CONFIG_SPMI=y
CONFIG_SPMI_MSM_PMIC_ARB=y
CONFIG_MSM_QPNP_INT=y
CONFIG_DEBUG_GPIO=y
CONFIG_GPIO_SYSFS=y
CONFIG_GPIO_QPNP_PIN=y
CONFIG_POWER_SUPPLY=y
CONFIG_SMB1360_CHARGER_FG=y
CONFIG_BATTERY_BCL=y
CONFIG_QPNP_VM_BMS=y
CONFIG_QPNP_LINEAR_CHARGER=y
CONFIG_POWER_RESET=y
CONFIG_POWER_RESET_MSM=y
CONFIG_SENSORS_QPNP_ADC_VOLTAGE=y
CONFIG_SENSORS_QPNP_ADC_CURRENT=y
CONFIG_SENSORS_QPNP_CURRENT_MONITOR=y
CONFIG_THERMAL=y
CONFIG_THERMAL_TSENS8974=y
CONFIG_THERMAL_MONITOR=y
CONFIG_THERMAL_QPNP=y
CONFIG_THERMAL_QPNP_ADC_TM=y
CONFIG_REGULATOR=y
CONFIG_REGULATOR_FIXED_VOLTAGE=y
CONFIG_REGULATOR_PROXY_CONSUMER=y
CONFIG_REGULATOR_MEM_ACC=y
CONFIG_REGULATOR_TPS65132=y
CONFIG_REGULATOR_STUB=y
CONFIG_REGULATOR_RPM_SMD=y
CONFIG_REGULATOR_QPNP=y
CONFIG_REGULATOR_SPM=y
CONFIG_REGULATOR_CPR=y
CONFIG_MEDIA_SUPPORT=y
CONFIG_MEDIA_CAMERA_SUPPORT=y
CONFIG_MEDIA_RADIO_SUPPORT=y
CONFIG_VIDEOBUF2_MSM_MEM=y
CONFIG_MEDIA_CONTROLLER=y
CONFIG_VIDEO_V4L2_SUBDEV_API=y
CONFIG_VIDEOBUF2_MSM_MEM=y
CONFIG_V4L_PLATFORM_DRIVERS=y
CONFIG_MSMB_CAMERA=y
CONFIG_MSM_CAMERA_SENSOR=y
CONFIG_MSM_CPP=y
CONFIG_MSM_CCI=y
CONFIG_MSM_CSI30_HEADER=y
CONFIG_MSM_CSIPHY=y
CONFIG_MSM_CSID=y
CONFIG_MSM_EEPROM=y
CONFIG_MSM_ISPIF=y
CONFIG_MT9M114=y
CONFIG_OV5645=y
CONFIG_MSMB_JPEG=y
CONFIG_MSM_VIDC_V4L2=y
CONFIG_RADIO_IRIS=y
CONFIG_RADIO_IRIS_TRANSPORT=m
CONFIG_MSM_KGSL=y
CONFIG_KGSL_PER_PROCESS_PAGE_TABLE=y
CONFIG_FB=y
CONFIG_FB_VIRTUAL=y
CONFIG_FB_MSM=y
# CONFIG_FB_MSM_BACKLIGHT is not set
CONFIG_FB_MSM_MDSS=y
CONFIG_FB_MSM_MDSS_WRITEBACK=y
CONFIG_BACKLIGHT_LCD_SUPPORT=y
# CONFIG_LCD_CLASS_DEVICE is not set
CONFIG_BACKLIGHT_CLASS_DEVICE=y
# CONFIG_BACKLIGHT_GENERIC is not set
CONFIG_SOUND=y
CONFIG_SND=y
CONFIG_SND_SOC=y
CONFIG_SND_SOC_MSM8X16=y
CONFIG_UHID=y
CONFIG_HID_APPLE=y
CONFIG_HID_MAGICMOUSE=y
CONFIG_HID_MICROSOFT=y
CONFIG_HID_ELECOM=y
CONFIG_USB_ANNOUNCE_NEW_DEVICES=y
CONFIG_USB_MON=y
CONFIG_USB_EHCI_HCD=y
CONFIG_USB_EHCI_MSM=y
CONFIG_USB_EHCI_EHSET=y
CONFIG_USB_ICE40_HCD=m
CONFIG_USB_ACM=y
CONFIG_USB_CCID_BRIDGE=y
CONFIG_USB_STORAGE=y
CONFIG_USB_STORAGE_DATAFAB=y
CONFIG_USB_STORAGE_FREECOM=y
CONFIG_USB_STORAGE_ISD200=y
CONFIG_USB_STORAGE_USBAT=y
CONFIG_USB_STORAGE_SDDR09=y
CONFIG_USB_STORAGE_SDDR55=y
CONFIG_USB_STORAGE_JUMPSHOT=y
CONFIG_USB_STORAGE_ALAUDA=y
CONFIG_USB_STORAGE_ONETOUCH=y
CONFIG_USB_STORAGE_KARMA=y
CONFIG_USB_STORAGE_CYPRESS_ATACB=y
CONFIG_USB_SERIAL=y
CONFIG_USB_SERIAL_CSVT=y
CONFIG_USB_EHSET_TEST_FIXTURE=y
CONFIG_USB_PHY=y
CONFIG_USB_GADGET=y
CONFIG_USB_GADGET_DEBUG_FILES=y
CONFIG_USB_GADGET_DEBUG_FS=y
CONFIG_USB_CI13XXX_MSM=y
CONFIG_USB_G_ANDROID=y
CONFIG_MMC=y
CONFIG_MMC_PERF_PROFILING=y
CONFIG_MMC_UNSAFE_RESUME=y
CONFIG_MMC_CLKGATE=y
CONFIG_MMC_EMBEDDED_SDIO=y
CONFIG_MMC_PARANOID_SD_INIT=y
CONFIG_MMC_BLOCK_MINORS=32
CONFIG_MMC_TEST=m
CONFIG_MMC_BLOCK_TEST=m
CONFIG_MMC_SDHCI=y
CONFIG_MMC_SDHCI_PLTFM=y
CONFIG_MMC_SDHCI_MSM=y
CONFIG_LEDS_QPNP=y
CONFIG_LEDS_GPIO=y
CONFIG_LEDS_TRIGGERS=y
CONFIG_SWITCH=y
CONFIG_RTC_CLASS=y
CONFIG_RTC_DRV_QPNP=y
CONFIG_UIO=y
CONFIG_UIO_MSM_SHAREDMEM=y
CONFIG_STAGING=y
CONFIG_ZSMALLOC=y
CONFIG_ZRAM=y
CONFIG_ANDROID=y
CONFIG_ANDROID_BINDER_IPC=y
CONFIG_ASHMEM=y
CONFIG_ANDROID_LOGGER=y
CONFIG_ANDROID_TIMED_GPIO=y
CONFIG_ANDROID_LOW_MEMORY_KILLER=y
CONFIG_ANDROID_INTF_ALARM_DEV=y
CONFIG_ION=y
CONFIG_ION_MSM=y
CONFIG_SPS=y
CONFIG_USB_BAM=y
CONFIG_SPS_SUPPORT_NDP_BAM=y
CONFIG_QPNP_POWER_ON=y
CONFIG_QPNP_VIBRATOR=y
CONFIG_QPNP_REVID=y
CONFIG_MSM_MDSS_PLL=y
CONFIG_REMOTE_SPINLOCK_MSM=y
CONFIG_MSM_IOMMU_V1=y
CONFIG_PWM=y
CONFIG_PWM_QPNP=y
CONFIG_MOBICORE_SUPPORT=m
CONFIG_MOBICORE_API=m
#/*<DTS2014061900098 p00105636 20140612 delete by Qualcomm Suggestion for Saving Memroy begin*/
#CONFIG_CORESIGHT=y
#CONFIG_CORESIGHT_FUSE=y
#CONFIG_CORESIGHT_TMC=y
#CONFIG_CORESIGHT_TPIU=y
#CONFIG_CORESIGHT_FUNNEL=y
#CONFIG_CORESIGHT_REPLICATOR=y
#CONFIG_CORESIGHT_STM=y
#CONFIG_CORESIGHT_HWEVENT=y
#CONFIG_CORESIGHT_MODEM_ETM=y
#CONFIG_CORESIGHT_WCN_ETM=y
#CONFIG_CORESIGHT_RPM_ETM=y
#CONFIG_CORESIGHT_QPDI=y
#CONFIG_CORESIGHT_ETMV4=y
#/*DTS2014061900098 p00105636 20140612 delete by Qualcomm Suggestion for Saving Memroy end>*/
CONFIG_SENSORS=y
CONFIG_MSM_BAM_DMUX=y
CONFIG_MSM_IPC_ROUTER_SMD_XPRT=y
CONFIG_MSM_QMI_INTERFACE=y
CONFIG_MSM_SMD=y
CONFIG_MSM_SMD_DEBUG=y
CONFIG_MSM_RUN_QUEUE_STATS=y
CONFIG_MSM_SMEM=y
CONFIG_MSM_SMEM_LOGGING=y
CONFIG_MSM_SMP2P=y
CONFIG_MSM_SMP2P_TEST=y
CONFIG_MSM_SPM_V2=y
CONFIG_MSM_L2_SPM=y
CONFIG_MSM_WATCHDOG_V2=y
CONFIG_MSM_MEMORY_DUMP_V2=y
CONFIG_MSM_SUBSYSTEM_RESTART=y
CONFIG_MSM_COMMON_LOG=y
CONFIG_MSM_SYSMON_COMM=y
CONFIG_MSM_PIL=y
CONFIG_MSM_PIL_SSR_GENERIC=y
CONFIG_MSM_PIL_MSS_QDSP6V5=y
CONFIG_MSM_SCM=y
CONFIG_MEM_SHARE_QMI_SERVICE=y
#/* < DTS2014041705903 zhangmin 20140418 begin */
CONFIG_HUAWEI_HW_DEV_DCT=y
#/* DTS2014041705903 zhangmin 20140418 end > */
CONFIG_EXT2_FS=y
CONFIG_EXT2_FS_XATTR=y
CONFIG_EXT3_FS=y
# CONFIG_EXT3_DEFAULTS_TO_ORDERED is not set
CONFIG_EXT4_FS=y
CONFIG_EXT4_FS_XATTR=y
CONFIG_EXT4_FS_SECURITY=y
CONFIG_FUSE_FS=y
#/* < DTS2014050406410 wenshuai 20140504 begin */
CONFIG_SDCARD_FS=y
#/* DTS2014050406410 wenshuai 20140504 end > */
CONFIG_VFAT_FS=y
CONFIG_TMPFS=y
CONFIG_NLS_CODEPAGE_437=y
CONFIG_NLS_ASCII=y
CONFIG_NLS_ISO8859_1=y
CONFIG_PRINTK_TIME=y
CONFIG_MAGIC_SYSRQ=y
#/*<DTS2014061900098 p00105636 20140612 delete by Qualcomm Suggestion for Saving Memroy begin*/
#CONFIG_PAGE_OWNER=y
#CONFIG_LOCKUP_DETECTOR=y
#CONFIG_BOOTPARAM_SOFTLOCKUP_PANIC=y
# CONFIG_DETECT_HUNG_TASK is not set
CONFIG_PANIC_ON_RT_THROTTLING=y
CONFIG_SCHEDSTATS=y
CONFIG_TIMER_STATS=y
#CONFIG_DEBUG_KMEMLEAK=y
#CONFIG_DEBUG_KMEMLEAK_DEFAULT_OFF=y
#CONFIG_DEBUG_SPINLOCK=y
CONFIG_DEBUG_MUTEXES=y
CONFIG_DEBUG_ATOMIC_SLEEP=y
CONFIG_DEBUG_STACK_USAGE=y
# CONFIG_SCHED_DEBUG is not set
# CONFIG_DEBUG_PREEMPT is not set
# CONFIG_DEBUG_BUGVERBOSE is not set
CONFIG_DEBUG_INFO=y
CONFIG_DEBUG_MEMORY_INIT=y
#CONFIG_DEBUG_LIST=y
#CONFIG_FAULT_INJECTION=y
#CONFIG_FAIL_PAGE_ALLOC=y
#CONFIG_FAULT_INJECTION_DEBUG_FS=y
#CONFIG_FAULT_INJECTION_STACKTRACE_FILTER=y
CONFIG_DEBUG_PAGEALLOC=y
#CONFIG_MSM_RTB=y
#CONFIG_MSM_RTB_SEPARATE_CPUS=y
CONFIG_IPC_LOGGING=y
#CONFIG_DYNAMIC_DEBUG=y
#CONFIG_PANIC_ON_DATA_CORRUPTION=y
CONFIG_DEBUG_USER=y
# CONFIG_FTRACE is not set
#CONFIG_FREE_PAGES_RDONLY=y
#CONFIG_DEBUG_LL=y
#CONFIG_EARLY_PRINTK=y
#/* DTS2014061900098 p00105636 20140612 delete by Qualcomm Suggestion for Saving Memroy end >*/
CONFIG_DEBUG_SET_MODULE_RONX=y
CONFIG_KEYS=y
CONFIG_SECURITY=y
CONFIG_SECURITY_NETWORK=y
CONFIG_LSM_MMAP_MIN_ADDR=4096
CONFIG_SECURITY_SELINUX=y
CONFIG_CRYPTO_MD4=y
CONFIG_CRYPTO_ARC4=y
CONFIG_CRYPTO_TWOFISH=y
CONFIG_CRYPTO_DEV_QCRYPTO=m
CONFIG_CRYPTO_DEV_QCE=y
CONFIG_CRYPTO_DEV_QCEDEV=y
CONFIG_CRYPTO_NULL=y
CONFIG_CRYPTO_ECB=y
CONFIG_CRYPTO_XCBC=y
CONFIG_CRYPTO_SHA256=y
#/* < DTS2014040104155 xufeng 20140401 begin */
CONFIG_HUAWEI_KERNEL=y
CONFIG_APP_INFO=y
#/* DTS2014040104155 xufeng 20140401 end > */
CONFIG_MSM_BUSPM_DEV=m
CONFIG_SOCKEV_NLMCAST=y
CONFIG_MSM_AVTIMER=y
#/* < DTS2014071502649  tanyanying 20140714 begin */
CONFIG_HUAWEI_THERMAL=y
#/* DTS2014071502649  tanyanying 20140714 end > */
#/* < DTS2014042401259 duxiao 20140423 begin */
CONFIG_INPUT_KEYCHORD=y
CONFIG_HUAWEI_KERNEL_DEBUG=y
#/* DTS2014042401259 duxiao 20140423 end > */
#/* <DTS2014042409252 d00238048 20140505 begin */
CONFIG_FB_AUTO_CABC=y
#/* DTS2014042409252 d00238048 20140505 end> */
#/* < DTS2014042500432 zhaoyuxia 20140225 begin */
#/*<DTS2014071602538 wuliuzhen 20140716 begin*/
# CONFIG_INPUT_EVBUG is not set
CONFIG_INPUT_HW_ATE=y
#/*<DTS2014071602538 wuliuzhen 20140716 begin*/
CONFIG_HUAWEI_LCD=y
#/* DTS2014042500432 zhaoyuxia 20140225 end > */
#/* < DTS2014042500397 shiguojun 20140425 begin */
CONFIG_FEATURE_HUAWEI_EMERGENCY_DATA=y
CONFIG_EXT4_HUAWEI_READ_ONLY_RECOVERY=y
#/* DTS2014042500397 shiguojun 20140425 end > */
#/* < DTS2014042606672 gaoxu 20140424 begin */
CONFIG_HW_MMC_TOSHIBA_HEALTH_API=y
CONFIG_HW_MMC_TEST=y
#/* DTS2014042606672 gaoxu 20140424 end > */
# /*< DTS2014060604389 zhaiqi 20140606 begin */

# /* DTS2014060604389 zhaiqi 20140606 end >*/
# /*< DTS2014050505717 zhaiqi 20140505 begin */
CONFIG_MEMCG=y
CONFIG_MEMCG_SWAP=y
CONFIG_MEMCG_KMEM=y
# /* DTS2014050505717 zhaiqi 20140505 end >*/
#/*< DTS2014050700450 gaoxu 20140507 begin*/
CONFIG_EXT4_HUAWEI_READ_ONLY_RECOVERY=y
#/*DTS2014050700450 gaoxu 20140507 end >*/
#/* < DTS2014042405184 duanhuan 20140611 begin */
CONFIG_HW_FEATURE_STORAGE_DIAGNOSE_LOG=y
#/* DTS2014042405184 duanhuan 20140611 end > */
#/*< DTS2014052207729 renxigang 20140520 begin */
CONFIG_FB_MSM_MDSS_DSI_CTRL_STATUS=y
#/* DTS2014052207729 renxigang 20140520 end >*/
#/* < DTS2014051405188 wangjian 20140515 begin */
CONFIG_HID_A4TECH=y
CONFIG_HID_ACRUX=y
CONFIG_HID_APPLE=y
CONFIG_HID_AUREAL=y
CONFIG_HID_BELKIN=y
CONFIG_HID_CHERRY=y
CONFIG_HID_CHICONY=y
CONFIG_HID_CYPRESS=y
CONFIG_HID_DRAGONRISE=y
CONFIG_HID_EMS_FF=y
CONFIG_HID_ELECOM=y
CONFIG_HID_EZKEY=y
CONFIG_HID_GYRATION=y
CONFIG_HID_HOLTEK=y
CONFIG_HID_HOLTEK=y
CONFIG_HID_HYPERV_MOUSE=y
CONFIG_HID_ICADE=y
CONFIG_HID_KENSINGTON=y
CONFIG_HID_KEYTOUCH=y
CONFIG_HID_KYE=y
CONFIG_HID_LCPOWER=y
CONFIG_HID_LENOVO_TPKBD=y
CONFIG_HID_LOGITECH=y
CONFIG_HID_LOGITECH_DJ=y
CONFIG_HID_MAGICMOUSE=y
CONFIG_HID_MICROSOFT=y
CONFIG_HID_MONTEREY=y
CONFIG_HID_MULTITOUCH=y
CONFIG_HID_ORTEK=y
CONFIG_HID_PRODIKEYS=y
CONFIG_HID_PANTHERLORD=y
CONFIG_HID_PETALYNX=y
CONFIG_HID_PICOLCD=y
CONFIG_HID_PRIMAX=y
CONFIG_HID_PS3REMOTE=y
CONFIG_HID_ROCCAT=y
CONFIG_HID_SAITEK=y
CONFIG_HID_SAMSUNG=y
CONFIG_HID_SMARTJOYPLUS=y
CONFIG_HID_SONY=y
CONFIG_HID_SPEEDLINK=y
CONFIG_HID_STEELSERIES=y
CONFIG_HID_SUNPLUS=y
CONFIG_HID_GREENASIA=y
CONFIG_HID_THINGM=y
CONFIG_HID_THRUSTMASTER=y
CONFIG_HID_TIVO=y
CONFIG_HID_TOPSEED=y
CONFIG_HID_TWINHAN=y
CONFIG_HID_UCLOGIC=y
CONFIG_HID_ZEROPLUS=y
CONFIG_HID_ZYDACRON=y
CONFIG_HID_WACOM=y
CONFIG_HID_WALTOP=y
CONFIG_HID_WIIMOTE=y
CONFIG_HID_SENSOR_HUB=y
#/* DTS2014051405188 wangjian 20140515 end > */
#/* < DTS2014051908036 liyuping 20140519 begin */
CONFIG_CHARGER_BQ24152=y
CONFIG_BATTERY_BQ27510=y
#/* DTS2014051908036 liyuping 20140519 end > */
#/* < DTS2014050804174 wanghui 20140523 begin */
CONFIG_HUAWEI_USB=y
#/* DTS2014050804174 wanghui 20140523 end > */
#/* < DTS2014052805125 liwei 20140528 begin */
CONFIG_DEBUG_VMALLOC=y
#/* DTS2014052805125 liwei 20140528 end > */
#/* < DTS2014060408745 roopesh 20140604 begin */
CONFIG_HUAWEI_FEATURE_NFF=y
#/* DTS2014060408745 roopesh 20140604 end > */
#/* < DTS2014052905391 gaoxu 20140610 begin */
CONFIG_HUAWEI_DEBUG_MODE=y
#/* DTS2014052905391 gaoxu 201140610 end > */
#/* < DTS2014061400183 jingbing 20140614 begin */
CONFIG_HW_SYSTEM_WR_PROTECT=y
#/* DTS2014061400183 jingbing 20140614 end > */
#/* < DTS2014072906208 chenjikun 20140729 begin */
#/*del DTS2014060603241 here temporary*/
#/* DTS2014072906208 chenjikun 20140729 end > */
#/*< DTS2014061200428 Wuzhen/w00213434 20140612 begin */
CONFIG_LOG_JANK=y
#/*DTS2014061200428 Wuzhen/w00213434 20140612 end > */
#/* < DTS2014062704895 zhaoyingchun 20140628 begin */
CONFIG_MMC_SWRM=y
#/* DTS2014062704895 zhaoyingchun 20140628 end > */
#/* < DTS2014062803742 jingbing 20140628 begin */
CONFIG_HW_SYSTEM_WR_PROTECT_ENABLE=y
#/* DTS2014062803742 jingbing 20140628 end > */
#/* < DTS2014070303497 shenjinming 20140703 begin */
CONFIG_DEBUG_HUAWEI_FLOW_LOGLEVEL=1
#/* DTS2014070303497 shenjinming 20140703 end > */
#/* < DTS2014071404370 shiguojun 20140714 begin */
CONFIG_SDCARD_FS_CI_SEARCH=y
#/* DTS2014071404370 shiguojun 20140714 end > */
#/* DTS2014071101173 hangtianqi hwx220732 20140711 begin */
CONFIG_HUAWEI_SDCARD_VOLD=y
#/* DTS2014071101173 hangtianqi hwx220732 20140711 end */
#/* < DTS2014062507748 zengfengming 20140626 begin */
CONFIG_HUAWEI_FEATURE_DIAG_MDLOG=y
#/* DTS2014062507748 zengfengming 20140626 end > */
#/* < DTS2014072602455 zhongming 20140726 begin */
#/* < DTS2014021207582 xufeng 20140212 begin */
CONFIG_HUAWEI_KSTATE=y
#/* DTS2014021207582 xufeng 20140212 end > */
#/* DTS2014072602455 zhongming 20140726 end > */
#/* < DTS2014072602310 zhaoyingchun 20140726 begin */
CONFIG_MMC_FFU=y
/* DTS2014072602310 zhaoyingchun 20140726 end > */
/* < DTS2014071608208 wuzhihui 20140805 begin */
CONFIG_UID_STAT=y
/* DTS2014071608208 wuzhihui 20140805 end > */
CONFIG_SCHED_HMP=y
#/* < DTS2014082110037 chenqihang 20140821 begin */
CONFIG_HUAWEI_STORE_EXCEPTION=y
#/* DTS2014082110037 chenqihang 20140821 end> */
```
